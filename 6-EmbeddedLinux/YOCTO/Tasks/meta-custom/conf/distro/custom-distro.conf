## 6-EmbeddedLinux/YOCTO/Tasks/meta-custom/conf/distro/custom-distro.conf
```bitbake
require conf/distro/poky.conf

DISTRO = "custom-distro"
DISTRO_NAME = "Custom Distro Version 1.0"
DISTRO_VERSION = "1.0"

DISTRO_FEATURES:remove = "ext2 3g nfc"

INIT_MANAGER = "systemd"

ENABLE_UART = "1"
```
